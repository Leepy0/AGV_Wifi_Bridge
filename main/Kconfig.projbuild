## main/Kconfig.projbuild
```kconfig
menu "AGV Wi-Fi Bridge"

    menu "Default config (runtime override: console 'set' + 'save')"

        config BR_AGV_ID
            int "AGV ID (1-99)"
            range 1 99
            default 1

        config BR_WIFI_SSID
            string "Wi-Fi SSID"
            default "AGV_TEST"

        config BR_WIFI_PASS
            string "Wi-Fi password (empty = open)"
            default "agv12345"

        config BR_STATIC_IP
            string "Static IP (empty = DHCP)"
            default ""

        config BR_NETMASK
            string "Netmask"
            default "255.255.255.0"

        config BR_GATEWAY
            string "Gateway"
            default "0.0.0.0"

        config BR_SERVER_IP
            string "Server (Gateway) IP"
            default "192.168.0.10"

        config BR_SERVER_PORT
            int "Server UDP port"
            range 1 65535
            default 50000

        config BR_LOCAL_PORT
            int "Local UDP port (downlink from server)"
            range 1 65535
            default 50000

        config BR_RFID_DST_IP
            string "RFID destination IP (255.255.255.255 = broadcast, empty = off)"
            default "255.255.255.255"

        config BR_RFID_DST_PORT
            int "RFID destination UDP port"
            range 1 65535
            default 50001

        config BR_MAIN_BAUD
            int "Main board (J4) baud rate"
            default 115200

        config BR_RFID_BAUD
            int "RFID reader baud rate"
            default 9600

        config BR_HB_MS
            int "Heartbeat period ms (0 = off)"
            range 0 60000
            default 1000

    endmenu

    menu "Wireless setup (phone BLE / SoftAP)"

        config BR_SETUP_BLE
            bool "BLE setup (phone BLE UART terminal app)"
            depends on BT_NIMBLE_ENABLED
            default y
            help
                설정 모드에서 BLE(Nordic UART Service)로 콘솔과 같은 명령을 받음.
                장치 이름 AGVBR-<호기>-<MAC 끝 4자리>. BT 컨트롤러는 설정 모드 동안만 켬.

        config BR_SETUP_BLE_PASS
            string "BLE setup password (empty = none)"
            depends on BR_SETUP_BLE
            default "agvsetup"
            help
                접속 후 'login <비밀번호>' 를 입력해야 명령 사용 가능. 현장에 맞게 바꾸세요.

        config BR_SETUP_SOFTAP
            bool "Wi-Fi SoftAP + web page setup"
            default n
            help
                설정 모드에서 AP(http://192.168.4.1)를 띄움. 사내 무선 보안(WIPS)이 있는 현장에서는
                차단되거나 비인가 AP 경보가 발생할 수 있어 기본으로 끔.

        config BR_SETUP_AP_PASS
            string "Setup AP password (8-63 chars, empty = open)"
            depends on BR_SETUP_SOFTAP
            default "agvsetup"

        config BR_SETUP_TIMEOUT_S
            int "Close setup mode after N s without a phone (only while Wi-Fi is connected)"
            range 30 3600
            default 300

        config BR_SETUP_FIRST_BOOT
            bool "Open setup mode when no config is saved (first install)"
            default y

        config BR_SETUP_BTN_GPIO
            int "Setup button GPIO (hold 3 s to open setup mode, -1 = none)"
            range -1 48
            default 0
            help
                기본값은 DevKitC 의 BOOT 버튼(GPIO0). 내부 풀업, 누르면 LOW.

    endmenu

    menu "Hardware pins"

        config BR_MAIN_TX_GPIO
            int "Main board UART1 TX GPIO (-> BOB T1IN)"
            default 17

        config BR_MAIN_RX_GPIO
            int "Main board UART1 RX GPIO (<- BOB R1OUT)"
            default 18

        config BR_RFID_TX_GPIO
            int "RFID UART2 TX GPIO (-> BOB T2IN)"
            default 4

        config BR_RFID_RX_GPIO
            int "RFID UART2 RX GPIO (<- BOB R2OUT)"
            default 5

    endmenu

    menu "Framing"

        config BR_MAIN_ETX_FRAMING
            bool "Main board RX: end frame at ETX (off = idle gap)"
            default y
            help
                ETX 를 받는 즉시 프레임을 전달. 체크섬 문자가 ETX 값과 겹치지 않아야 함.

        config BR_MAIN_ETX_CHAR
            hex "ETX byte"
            depends on BR_MAIN_ETX_FRAMING
            default 0x03

        config BR_MAIN_GAP_MS
            int "Main board RX: idle gap (ms) - frame end in gap mode, forced flush in ETX mode"
            range 1 20
            default 3

        config BR_RFID_GAP_MS
            int "RFID RX: idle gap that ends a frame (ms)"
            range 1 50
            default 5

        config BR_MAIN_TX_GAP_MS
            int "Min idle gap between frames sent to main board (ms, 0 = off)"
            range 0 20
            default 0

        config BR_RFID_TO_MAIN
            bool "Forward RFID frames to main board"
            default y

    endmenu

endmenu
```
